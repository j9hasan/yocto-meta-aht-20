## conf/layer.conf
```bitbake
# We have a conf and classes directory, add to BBPATH
BBPATH .= ":${LAYERDIR}"

# We have recipes-* directories, add to BBFILES
BBFILES += "${LAYERDIR}/recipes-*/*/*.bb \
            ${LAYERDIR}/recipes-*/*/*.bbappend"

BBFILE_COLLECTIONS += "yocto-meta-aht-20"
BBFILE_PATTERN_yocto-meta-aht-20 = "^${LAYERDIR}/"
BBFILE_PRIORITY_yocto-meta-aht-20 = "6"

LAYERDEPENDS_yocto-meta-aht-20 = "core"
LAYERSERIES_COMPAT_yocto-meta-aht-20 = "kirkstone"
```
